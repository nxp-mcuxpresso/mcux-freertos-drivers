## Kconfig
```kconfig
#
# Copyright 2024 NXP
#
# SPDX-License-Identifier: BSD-3-Clause

menu "FreeRTOS drivers"
    rsource "dspi/Kconfig"
    rsource "ecspi/Kconfig"
    rsource "flexcomm/i2c/Kconfig"
    rsource "flexcomm/spi/Kconfig"
    rsource "flexcomm/usart/Kconfig"
    rsource "i2c/Kconfig"
    rsource "ii2c/Kconfig"
    rsource "iuart/Kconfig"
    rsource "lpc_i2c/Kconfig"
    rsource "lpc_vspi/Kconfig"
    rsource "lpc_vusart/Kconfig"
    rsource "lpflexcomm/lpi2c/Kconfig"
    rsource "lpflexcomm/lpspi/Kconfig"
    rsource "lpflexcomm/lpuart/Kconfig"
    rsource "lpi2c/Kconfig"
    rsource "lpsci/Kconfig"
    rsource "lpspi/Kconfig"
    rsource "lpuart/Kconfig"
    rsource "spi/Kconfig"
    rsource "uart/Kconfig"
endmenu
```

## dspi/Kconfig
```kconfig
#
# Copyright 2024 NXP
#
# SPDX-License-Identifier: BSD-3-Clause

config MCUX_COMPONENT_driver.dspi_freertos
    bool "dspi_freertos"
    select MCUX_COMPONENT_driver.dspi
    select MCUX_COMPONENT_middleware.freertos-kernel
```

## ecspi/Kconfig
```kconfig
#
# Copyright 2024 NXP
#
# SPDX-License-Identifier: BSD-3-Clause

config MCUX_COMPONENT_driver.ecspi_freertos
    bool "ecspi_freertos"
    select MCUX_COMPONENT_driver.ecspi
    select MCUX_COMPONENT_middleware.freertos-kernel
```

## flexcomm/i2c/Kconfig
```kconfig
#
# Copyright 2024 NXP
#
# SPDX-License-Identifier: BSD-3-Clause

config MCUX_COMPONENT_driver.flexcomm_i2c_freertos
    bool "flexcomm_i2c_freertos"
    select MCUX_COMPONENT_driver.flexcomm
    select MCUX_COMPONENT_driver.common
    select MCUX_COMPONENT_driver.flexcomm_i2c
    select MCUX_COMPONENT_middleware.freertos-kernel
```

## flexcomm/usart/Kconfig
```kconfig
#
# Copyright 2024 NXP
#
# SPDX-License-Identifier: BSD-3-Clause

config MCUX_COMPONENT_driver.flexcomm_usart_freertos
    bool "flexcomm_usart_freertos"
    select MCUX_COMPONENT_driver.flexcomm
    select MCUX_COMPONENT_driver.flexcomm_usart
    select MCUX_COMPONENT_middleware.freertos-kernel
```

## ii2c/Kconfig
```kconfig
#
# Copyright 2024 NXP
#
# SPDX-License-Identifier: BSD-3-Clause

config MCUX_COMPONENT_driver.ii2c_freertos
    bool "ii2c_freertos"
    select MCUX_COMPONENT_driver.ii2c
    select MCUX_COMPONENT_middleware.freertos-kernel
```

## iuart/Kconfig
```kconfig
#
# Copyright 2024 NXP
#
# SPDX-License-Identifier: BSD-3-Clause

config MCUX_COMPONENT_driver.iuart_freertos
    bool "iuart_freertos"
    select MCUX_COMPONENT_driver.iuart
    select MCUX_COMPONENT_middleware.freertos-kernel
```

## lpc_vusart/Kconfig
```kconfig
#
# Copyright 2024 NXP
#
# SPDX-License-Identifier: BSD-3-Clause

config MCUX_COMPONENT_driver.vusart_freertos
    bool "vusart_freertos"
    select MCUX_COMPONENT_driver.vusart
    select MCUX_COMPONENT_middleware.freertos-kernel
```

## lpflexcomm/lpi2c/Kconfig
```kconfig
#
# Copyright 2024 NXP
#
# SPDX-License-Identifier: BSD-3-Clause

config MCUX_COMPONENT_driver.lpflexcomm_lpi2c_freertos
    bool "lpflexcomm_lpi2c_freertos"
    select MCUX_COMPONENT_driver.common
    select MCUX_COMPONENT_driver.lpflexcomm
    select MCUX_COMPONENT_driver.lpflexcomm_lpi2c
    select MCUX_COMPONENT_middleware.freertos-kernel
```

## lpflexcomm/lpspi/Kconfig
```kconfig
#
# Copyright 2024 NXP
#
# SPDX-License-Identifier: BSD-3-Clause

config MCUX_COMPONENT_driver.lpflexcomm_lpspi_freertos
    bool "lpflexcomm_lpspi_freertos"
    select MCUX_COMPONENT_driver.common
    select MCUX_COMPONENT_driver.lpflexcomm
    select MCUX_COMPONENT_driver.lpspi
    select MCUX_COMPONENT_middleware.freertos-kernel
```

## lpsci/Kconfig
```kconfig
#
# Copyright 2024 NXP
#
# SPDX-License-Identifier: BSD-3-Clause

config MCUX_COMPONENT_driver.lpsci_freertos
    bool "lpsci_freertos"
    select MCUX_COMPONENT_driver.lpsci
    select MCUX_COMPONENT_middleware.freertos-kernel
```

## lpspi/Kconfig
```kconfig
#
# Copyright 2024 NXP
#
# SPDX-License-Identifier: BSD-3-Clause

config MCUX_COMPONENT_driver.lpspi_freertos
    bool "lpspi_freertos"
    select MCUX_COMPONENT_driver.lpspi
    select MCUX_COMPONENT_middleware.freertos-kernel
```

## lpuart/Kconfig
```kconfig
#
# Copyright 2024 NXP
#
# SPDX-License-Identifier: BSD-3-Clause

config MCUX_COMPONENT_driver.lpuart_freertos
    bool "lpuart_freertos"
    select MCUX_COMPONENT_driver.lpuart
    select MCUX_COMPONENT_middleware.freertos-kernel
```

## smartcard/Kconfig
```kconfig
#
# Copyright 2024 NXP
#
# SPDX-License-Identifier: BSD-3-Clause

config MCUX_COMPONENT_driver.smartcard_freertos
    bool "smartcard_freertos"
    select MCUX_COMPONENT_driver.smartcard_uart
    select MCUX_COMPONENT_middleware.freertos-kernel
```

## spi/Kconfig
```kconfig
#
# Copyright 2024 NXP
#
# SPDX-License-Identifier: BSD-3-Clause

config MCUX_COMPONENT_driver.spi_freertos
    bool "spi_freertos"
    select MCUX_COMPONENT_driver.spi
    select MCUX_COMPONENT_middleware.freertos-kernel
```

## uart/Kconfig
```kconfig
#
# Copyright 2024 NXP
#
# SPDX-License-Identifier: BSD-3-Clause

config MCUX_COMPONENT_driver.uart_freertos
    bool "uart_freertos"
    select MCUX_COMPONENT_driver.uart
    select MCUX_COMPONENT_middleware.freertos-kernel
```
